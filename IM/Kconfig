## IM/Kconfig
```kconfig
menu "IM Config"
    config OUTBOUND_STACK_SIZE
        int "IM outbound thread stack size (bytes)"
        default 12288
        help
            Stack size in bytes for the IM outbound thread (default 12*1024).
    config IM_FS_POLL_STACK
        int "IM feishu poll thread stack size (bytes)"
        default 16384
        help
            Stack size in bytes for the IM feishu poll thread (default 16*1024).
    config IM_TG_POLL_STACK
        int "IM telegram poll thread stack size (bytes)"
        default 12288
        help
            Stack size in bytes for the IM telegram poll thread (default 12*1024).
    config IM_DC_POLL_STACK
        int "IM discord poll thread stack size (bytes)"
        default 12288
        help
            Stack size in bytes for the IM discord poll thread (default 12*1024).
    config IM_WX_POLL_STACK
        int "IM weixin poll thread stack size (bytes)"
        default 14336
        help
            Stack size in bytes for the IM weixin poll thread (default 14*1024).
    config IM_WX_QR_STACK
        int "IM weixin QR code thread stack size (bytes)"
        default 10240
        help
            Stack size in bytes for the IM weixin QR code thread (default 10*1024).
    config IM_QQ_POLL_STACK
        int "IM qqbot gateway thread stack size (bytes)"
        default 14336
        help
            Stack size in bytes for the IM qqbot WebSocket gateway thread (default 14*1024).
    config IM_QQ_TOKEN_STACK
        int "IM qqbot token refresh thread stack size (bytes)"
        default 8192
        help
            Stack size in bytes for the IM qqbot token refresh thread (default 8*1024).

    config IM_WX_UPDATES_BUF_SIZE
        int "Weixin get_updates cursor buffer (bytes)"
        default 4096
        help
            Cursor/state buffer for weixin long-poll. Allocated from PSRAM at
            weixin_bot_init. Lower on tight-SRAM boards.

    config IM_FS_DEDUP_CACHE_SIZE
        int "Feishu dedup ring cache entries (count)"
        default 512
        help
            Number of 8-byte FNV hashes kept per dedup ring (one for messages,
            one for events). 512 = 4 KiB per ring = 8 KiB total. Allocated
            from PSRAM at feishu_bot_init. Lower on tight-SRAM boards.

    config IM_TG_DEDUP_CACHE_SIZE
        int "Telegram dedup ring cache entries (count)"
        default 64
        help
            Number of 8-byte FNV hashes kept for telegram message dedup.
            Allocated from PSRAM at telegram_bot_init.

    config IM_QQ_DEDUP_CACHE_SIZE
        int "QQ bot dedup ring cache entries (count)"
        default 64
        help
            Number of 8-byte FNV hashes kept for QQ bot message dedup.
            Allocated from PSRAM at qqbot init.
endmenu
```

## Kconfig
```kconfig
menu "configure app (TuyaOpenClaw) "

    config SYS_BUS_OUTBOUND_STACK_SIZE
        int "SYS bus outbound thread stack size (bytes)"
        default 8192
        help
            Stack size in bytes for the SYS bus outbound thread (default 8*1024).

    config IM_BRIDGE_STACK_SIZE
        int "IM bridge thread stack size (bytes)"
        default 4096
        help
            Stack size in bytes for the IM bridge thread (default 4*1024).

config TUYAOPENCLAW_USE_AI_COMPONENTS
    bool
    default y
    select ENABLE_AI_COMPONENTS

# TuyaOpenClaw moves large app-level buffers (acp_client / ws_server / IM dedup rings)
# from static .bss into PSRAM heap via claw_malloc / im_calloc, which only does
# anything when ENABLE_EXT_RAM is on at the SDK level. Some board Kconfigs
# (e.g. ESP32S3_BREAD_COMPACT_WIFI in upstream TuyaOpen) don't `select
# ENABLE_EXT_RAM` on their own — opt into it from the app side so TuyaOpenClaw
# doesn't have to patch the submodule. Boards that already select it
# (DNESP32S3 family, WAVESHARE_ESP32S3, T5AI variants with PSRAM) are unaffected.
config TUYAOPENCLAW_USE_EXT_RAM
    bool "TuyaOpenClaw: enable external PSRAM heap"
    default y
    select ENABLE_EXT_RAM
    help
      Enable ENABLE_EXT_RAM from the application layer so claw_malloc,
      im_calloc, and tal_thread `psram_mode=1` land in PSRAM. Turn off
      on platforms without PSRAM (the option has no effect on platforms
      that don't declare ENABLE_EXT_RAM).

rsource "./cron_service/Kconfig"
rsource "./gateway/Kconfig"
rsource "./IM/Kconfig"
rsource "./agent/Kconfig"
rsource "./components/lua/Kconfig"
rsource "./tools/Kconfig"

endmenu
```

## agent/Kconfig
```kconfig
menu "TuyaOpenClaw Agent Config"
    config TUYAOPEN_CLAW_AGENT_STACK
        int "Agent loop thread stack size (bytes)"
        default 24576
        help
            Stack size in bytes for the agent loop thread (default 24*1024).

    config TUYAOPEN_CLAW_CONTEXT_BUF_SIZE
        int "Agent context buffer size (bytes)"
        default 32768
        help
            Size in bytes for the context/prompt buffer (default 32*1024).

    config TUYAOPEN_CLAW_HISTORY_MAX_COUNT
        int "Max history message count"
        default 10
        help
            Maximum number of history messages kept in context.
endmenu
```

## components/lua/Kconfig
```kconfig
menuconfig ENABLE_LUA
    bool "Enable embedded Lua 5.5 interpreter"
    default n
    help
        Enable the embedded Lua 5.5 interpreter that powers the
        lua_run_script MCP tool. When disabled, neither the interpreter
        nor the tool_lua wrapper are compiled in.

if ENABLE_LUA

config LUA_OUTPUT_BUFFER_SIZE
    int "Lua print/output capture buffer (bytes)"
    default 4096
    range 1024 32768
    help
        Maximum total bytes captured from Lua print() and runtime errors
        before truncation. The captured text is returned to the LLM as
        the tool result.

config LUA_DEFAULT_TIMEOUT_MS
    int "Default Lua execution timeout (ms)"
    default 3000
    range 100 60000
    help
        Wall-clock budget applied when the LLM does not specify
        timeout_ms. The runtime checks every ~100 bytecode instructions.

config ENABLE_LUA_MODULE_GPIO
    bool "Enable lua_module_gpio (GPIO control from Lua)"
    depends on ENABLE_LUA
    default n
    help
        Expose gpio.set_direction(), gpio.set_level(), gpio.get_level()
        to Lua scripts.  Requires a board with tkl_gpio support.

config ENABLE_LUA_MODULE_DELAY
    bool "Enable lua_module_delay (blocking delays from Lua)"
    depends on ENABLE_LUA
    default n
    help
        Expose delay.delay_ms() and delay.delay_us() to Lua scripts.
        delay_ms uses tal_system_sleep (yields the task); delay_us uses
        tkl_system_sleep_us and is capped at 1_000_000 us per call.

endif # ENABLE_LUA
```

## gateway/Kconfig
```kconfig
menu "Gateway (WebSocket) Config"
    config WS_SERVER_STACK_SIZE
        int "WebSocket server thread stack size (bytes)"
        default 10240
        help
            Stack size in bytes for the WebSocket server thread (default 10*1024).

    config ACP_CLIENT_STACK_SIZE
        int "ACP client thread stack size (bytes)"
        default 10240
        help
            Stack size in bytes for the ACP client thread (default 10*1024).

    config ACP_CLIENT_RX_BUF_SIZE
        int "ACP client RX scratch buffer (bytes)"
        default 8192
        help
            Raw socket RX buffer for the ACP gateway WebSocket client.
            Allocated from PSRAM at acp_client init; default 8 KiB.
            Tighten on internal-SRAM-constrained boards (e.g. ESP32-S3).

    config ACP_CLIENT_WS_MSG_BUF_SIZE
        int "ACP client WebSocket message reassembly buffer (bytes)"
        default 32768
        help
            Reassembles a single WebSocket text frame from the ACP gateway.
            Was the dominant .bss consumer (32 KiB) on this app prior to
            being moved to PSRAM. Lower on tight-SRAM boards.

    config ACP_CLIENT_REPLY_BUF_SIZE
        int "ACP client streaming reply accumulation buffer (bytes)"
        default 8192
        help
            Accumulates streaming chat reply chunks until final.
            Allocated from PSRAM at acp_client init.

    config CLAW_WS_MAX_CLIENTS
        int "WebSocket server max concurrent clients"
        default 4
        help
            Max simultaneous WS client connections served by claw_ws.

    config CLAW_WS_CLIENT_RX_BUF_SIZE
        int "WebSocket server per-client RX buffer (bytes)"
        default 4096
        help
            Per-client framing buffer. Allocated from PSRAM at ws_server_start.
endmenu
```

## tools/Kconfig
```kconfig
menu "Tools (Filesystem) Config"
    comment "Linux targets use the local filesystem (tal_fs). MCU-only options"
    comment "(SD card, hardware MCP, embedded Lua) are not available in this fork."
endmenu
```
